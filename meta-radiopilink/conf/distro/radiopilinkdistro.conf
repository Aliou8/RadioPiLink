## meta-radiopilink/conf/distro/radiopilinkdistro.conf
```bitbake
require conf/distro/poky.conf

DISTRO = "radiopilinkdistro"
DISTRO_NAME = "Radiopilink Raspberry Pi Linux"
DISTRO_VERSION = "1.0"
DISTRO_CODENAME = "scarthgap-derived"

# Compatibilité Yocto
DISTRO_COMPATIBILITY = "scarthgap"
# Info mainteneur et vendor
MAINTAINER = "Aliou LY <aliouly.emp@gmail.com>"
TARGET_VENDOR = "-radiopilink"

# -------------------------------------------------------------
#   DISTRO FEATURES
# -------------------------------------------------------------

BASE_FEATURES = "opengl wayland vulkan multiarch ipv6 ipv4 keyboard mouse nfsd"
DISTRO_FEATURES_DEFAULT = "ext2 ext4 nfs sshd usbhost pci mmc sdcard sata aes arm virtio vc4graphics wifi bluetooth "
DISTRO_FEATURES ?= "${DISTRO_FEATURES_DEFAULT} ${BASE_FEATURES}"
SPLASH = "psplash-polleltech"
# ----------------------------------------------------------------
#   PACKAGE MANAGEMENT
# ----------------------------------------------------------------
# ipk recommandé sur Raspberry Pi
PACKAGE_CLASSES ?= "package_ipk"

# -------------------------------------------------------------
#   INIT SYSTEM
# -------------------------------------------------------------
DISTRO_FEATURES:append = " systemd"
VIRTUAL-RUNTIME_init_manager = "systemd"
VIRTUAL-RUNTIME_initscripts = ""

# -------------------------------------------------------------
#   KERNEL
# -------------------------------------------------------------
PREFERRED_PROVIDER_virtual/kernel = "linux-raspberrypi"
PREFERRED_VERSION_linux-raspberrypi = "6.12%"

# ------------------------------------------------------------
#   SDK SETTINGS
# -------------------------------------------------------------
SDK_MACHINE = "${MACHINE}"
SDK_VENDOR = "-radiopilinksdk"
SDK_VERSION = "${DISTRO_VERSION}"
SDK_NAME = "${DISTRO}-${TCLIBC}-${SDKMACHINE}-${IMAGE_BASENAME}-${TUNE_PKGARCH}-${MACHINE}"

# -------------------------------------------------------------
#   STD LIBC
# -------------------------------------------------------------
TCLIBC = "glibc"

# -------------------------------------------------------------
#   HASHING AND QA
# -------------------------------------------------------------
BB_SIGNATURE_HANDLER ?= "OEEquivHash"
BB_HASHSERVE ??= "auto"
WARN_QA:remove = "host-user-contaminated"
```

## meta-radiopilink/conf/layer.conf
```bitbake
# Ajouter le layer dans la recherche de fichiers
BBPATH .= ":${LAYERDIR}"

# Déclarer où se trouvent les recettes
BBFILES += "${LAYERDIR}/recipes-*/*/*.bb \
            ${LAYERDIR}/recipes-*/*/*.bbappend"

# Déclaration du layer dans BitBake
BBFILE_COLLECTIONS += "radiopilinklyer"

# Indiquer le pattern pour ce layer
BBFILE_PATTERN_radiopilinklyer = "^${LAYERDIR}/"

# Priorité du layer (plus grand = priorité plus haute)
BBFILE_PRIORITY_radiopilinklyer = "9"
```
